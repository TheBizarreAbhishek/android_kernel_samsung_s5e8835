## security/samsung/proca/proca_debug_defconfig
```kconfig
CONFIG_PROCA=m
CONFIG_PROCA_S_OS=y
CONFIG_PROCA_CERTIFICATES_DB=y
CONFIG_PROCA_GKI_20=y
CONFIG_PROCA_CERT_DEVICE=y
CONFIG_PROCA_DEBUG=y
CONFIG_PROCA_CERT_USER="x509_proca_user.der"
CONFIG_PROCA_CERT_ENG="x509_proca_eng.der"
```

## security/samsung/proca/proca_defconfig
```kconfig
CONFIG_PROCA=m
CONFIG_PROCA_S_OS=y
CONFIG_PROCA_CERTIFICATES_DB=y
CONFIG_PROCA_GKI_20=y
CONFIG_PROCA_CERT_USER="x509_proca_user.der"
```
